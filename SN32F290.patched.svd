# SN32F290 register map
Vendor: SONIX; File version: 2026.10.03
ARM 32-bit Cortex-M0 Microcontroller based device, CPU clock up to 48MHz, etc.
CPU: CM0 r0p0, little endian, no MPU, no FPU, 2 interrupt priority bits
Registers are 32-bit, read-write, reset 0x0 unless marked. A register's access mark holds for its fields unless they carry their own. Offsets are from the block's base; lines under a group give offsets from that group; [hi:lo] are bit positions; {n}, {i} and the like mark numbered series; 'fields as' and 'values as' point back to an identical list; <NAME> marks a mode.

## Memory map
0x1FFF2450 SN_UC size 0x2000 — UC Registers
0x40000000 SN_CT16B0 size 0x2000 — 16-bit Timer 0 with Capture function
0x40002000 SN_CT16B1 size 0x2000 — 16-bit Timer 1 with Capture function
0x40004000 SN_CT16B2 size 0x2000 — 16-bit Timer 2 with Capture function
0x40006000 SN_CT16B3 size 0x2000 — 16-bit Timer 3 with Capture function
0x40008000 SN_CT16B4 size 0x2000 — 16-bit Timer 3 with Capture function
0x4000A000 SN_CT16B5 size 0x2000 — 16-bit Timer 5 with Capture function
0x40010000 SN_WDT size 0x2000 — Watchdog Timer
0x40012000 SN_RTC size 0x2000 — Real-time Clock
0x40014000 SN_I2S1 size 0x2000 — I2S
0x40016000 SN_UART0 size 0x2000 — UART0
0x40018000 SN_I2C0 size 0x2000 — I2C0
0x4001A000 SN_I2S0 size 0x2000 — I2S
0x4001C000 SN_SPI0 size 0x2000 — SPI0
0x40026000 SN_ADC size 0x2000 — ADC
0x40028000 SN_CMP size 0x2000 — Comparator
0x4002A000 SN_OPA size 0x2000 — OP Amplifier
0x40032000 SN_PMU size 0x2000 — Power Management Unit
0x40034000 SN_LCD size 0x2000 — LCD Driver
0x40036000 SN_EBI size 0x2000 — External Bus Interface
0x40038000 SN_CRC size 0x2000 — Cyclic Redundancy Check
0x40042000 SN_PFPA size 0x2000 — Peripheral Function Pin Assignment
0x40044000 SN_GPIO0 size 0x2000 — General Purpose I/O
0x40046000 SN_GPIO1 size 0x2000 — General Purpose I/O
0x40048000 SN_GPIO2 size 0x2000 — General Purpose I/O
0x4004A000 SN_GPIO3 size 0x2000 — General Purpose I/O
0x40052000 SN_UART3 size 0x2000 — UART0
0x40054000 SN_UART2 size 0x2000 — UART0
0x40056000 SN_UART1 size 0x2000 — UART0
0x40058000 SN_SPI1 size 0x2000 — SPI1
0x4005A000 SN_I2C1 size 0x2000 — I2C0
0x4005C000 SN_USB size 0x2000 — Universal Serial Bus Full Speed Device Interface (USB)
0x4005E000 SN_SYS1 size 0x2000 — System Control Registers 1
0x40060000 SN_SYS0 size 0x2000 — System Control Registers 0
0x40062000 SN_FLASH size 0x2000 — FLASH Memory Control Registers

## Interrupts
0 NDT (SN_SYS0) — Noise Detection
1 USB (SN_USB)
2 LCD (SN_LCD) — LCD Driver
3 I2S0 (SN_I2S0)
4 I2S1 (SN_I2S1)
5 CMP3 (SN_CMP)
6 SPI0 (SN_SPI0)
7 SPI1 (SN_SPI1)
8 UART2 (SN_UART2)
9 UART3 (SN_UART3)
10 I2C0 (SN_I2C0)
11 I2C1 (SN_I2C1)
12 CMP2 (SN_CMP)
13 UART0 (SN_UART0)
14 UART1 (SN_UART1)
15 CT16B0 (SN_CT16B0) — 16-bit Timer 0
16 CT16B1 (SN_CT16B1)
17 CT16B2 (SN_CT16B2) — 16-bit Timer 2
18 CMP1 (SN_CMP)
19 CT16B3 (SN_CT16B3) — 16-bit Timer 3
20 CT16B4 (SN_CT16B4) — 16-bit Timer 4
21 CT16B5 (SN_CT16B5) — 16-bit Timer 5
22 EBI (SN_EBI) — External Bus Interface
23 RTC (SN_RTC) — Real-time Clock
24 ADC (SN_ADC)
25 WDT (SN_WDT) — Watchdog Timer
26 LVD (SN_SYS0) — Low Voltage Detection
27 CMP0 (SN_CMP)
28 P3 (SN_GPIO3) — GPIO3
29 P2 (SN_GPIO2) — GPIO2
30 P1 (SN_GPIO1) — GPIO1
31 P0 (SN_GPIO0) — GPIO0

## SN_ADC — ADC
Base 0x40026000
0x00 ADM (reset mask 0x1FFFF) — Offset:0x00 ADC Management Register
  [30:14] VHS — Internal Ref. voltage source
    0=V_000b_5 (Internal 2.0V as ADC internal reference high voltage); 1=V_001b_13 (Internal 3.0V as ADC internal reference high voltage); 2=V_010b_18 (Internal 4.5V as ADC internal reference high voltage); 4=V_100b (VDD as ADC internal reference high voltage, Internal 2.0V as AIN10); 5=V_101b_5 (VDD as ADC internal reference high voltage, Internal 3.0V as AIN10); 6=V_110b (VDD as ADC internal reference high voltage, Internal 4.5V as AIN10); 7=V_111b_11 (VDD as ADC internal reference high voltage)
  [26:13] AVREFHSEL — ADC high reference voltage source
    0=Interal_VDD (P2.0 acts as GPIO or AIN0 pin); 1=External_reference_voltage (P2.0 acts as AVREFH pin)
  [24:12] ADENB — ADC enable
    0=Disable_434 (Disable ADC); 1=Enable_145 (Enable ADC)
  [20:9] ADCKS — ADC clock source divider
    0=V_000b_5 (ADC_PCLK/1); 1=V_001b_13 (ADC_PCLK/2); 2=V_010b_18 (ADC_PCLK/4); 3=V_011b_3 (ADC_PCLK/8); 5=V_101b_5 (ADC_PCLK/16); 6=V_110b (ADC_PCLK/32)
  [16:8] ADLEN — ADC resolution
    0=V_8_bit_5 (8-bit ADB); 1=V_12_bit (12-bit ADB)
  [14:7] ADS — ADC start control
    0=Stop_5 (ADC stopped); 1=Start_2 (Start ADC conversion)
  [12:6] EOC — ADC status
    0=Busy_5 (ADC processing); 1=End_4 (End of conversion)
  [10:5] GCHS — ADC global channel enable
    0=Disable_434 (Disable AIN channel); 1=Enable_145 (Enable AIN channel)
  [4:0] CHS — ADC input channel
    0=V_0_164 (AIN0); 1=V_1_374 (AIN1); 10=V_10 (AIN10); 11=V_11_3 (AIN11); 12=V_12 (AIN12); 13=V_13_3 (AIN13); 14=V_14 (AIN14); 15=V_15 (AIN15); 16=V_16_8 (AIN16(Internal reference voltage 4.5V/3V/2V)); 17=V_17 (AIN17(OP0O)); 18=V_18_3 (AIN18(OP1O)); 2=V_2 (AIN2); 3=V_3_20 (AIN3); 4=V_4_16 (AIN4); 5=V_5 (AIN5); 6=V_6_9 (AIN6); 7=V_7_10 (AIN7); 8=V_8_2 (AIN8); 9=V_9_2 (AIN9)
0x04 ADB ro — Offset:0x04 ADC Data Register
  [11:0] ADB — ADB11~ADB4 bits for 8-bit ADC, ADB11~ADB0 bits for 12-bit ADC
0x0C IE (reset mask 0x7FFFF) — Offset:0x0C ADC Interrupt Enable Register
  [2n:n] IE{n} (n=1..18) — AIN{n} interrupt enable
    0=Disable_434 (Disable AIN{n} interrupt); 1=Enable_145 (ADC interrupt is triggered when AIN{n} completes ADC conversion)
  [0] IE0 — AIN0 interrupt enable
    0=Disable_434 (Disable AIN0 interrupt); 1=Enable_145 (ADC interrupt is triggered when AIN0 completes ADC conversion)
0x10 RIS (reset mask 0x7FFFF) — Offset:0x10 ADC Raw Interrupt Status Register
  [2n:n] EOCIF{n} (n=4..18) — AIN{n} interrupt flag
    0=No_interrupt_21 (No interrupt on AIN{n}); 1=Met_interrupt_requirements_37 (AIN{n} completes ADC conversion)
  [6:3] EOCIF3 — AIN0 interrupt flag
    0=No_interrupt_21 (No interrupt on AIN3); 1=Met_interrupt_requirements_37 (AIN3 completes ADC conversion)
  [4:2] EOCIF2 — AIN2 interrupt flag
    0=No_interrupt_21 (No interrupt on AIN2); 1=Met_interrupt_requirements_37 (AIN2 completes ADC conversion)
  [2:1] EOCIF1 — AIN1 interrupt flag
    0=No_interrupt_21 (No interrupt on AIN1); 1=Met_interrupt_requirements_37 (AIN1 completes ADC conversion)
  [0] EOCIF0 — AIN0 interrupt flag
    0=No_interrupt_21 (No interrupt on AIN0); 1=Met_interrupt_requirements_37 (AIN0 completes ADC conversion)
0x14 CALI (reset mask 0xDF) — Offset:0x14 ADC Calibration Register
