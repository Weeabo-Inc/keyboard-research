# SN32F290 register map
Vendor: SONIX; File version: 2026.10.03
CPU: CM0 r0p0, little endian, no MPU, no FPU, 2 interrupt priority bits
Registers are 32-bit, read-write, reset 0x0 unless marked. A register's access mark holds for its fields unless they carry their own. Offsets are from the block's base; [hi:lo] are bit positions; 'fields as' and 'values as' point back to an identical list.

## SN_CT16B3 — 16-bit Timer 3 with Capture function
Base 0x40006000
Same registers: SN_CT16B4 0x40008000
0x00 TMRCTRL (reset mask 0x7) — Offset:0x00 CT16Bn Timer Control Register
  [4:2] CLKSEL — PCLK source
    0=HCLK_5 (CT16Bn PCLK source=HCLK); 1=PLL_VCO_5 (CT16Bn PCLK source=PLL_VCO)
  [2:1] CRST — Counter Reset
    0=Disable_434; 1=Reset_Counter (Timer Counter and the Prescale Counter are synchronously reset on the next positive edge of PCLK)
  [0] CEN — Counter enable
    0=Disable_434 (Disable counter); 1=Enable_145 (Enable Timer Counter and Prescale Counter for counting)
0x04 TC — Offset:0x04 CT16Bn Timer Counter Register
  [15:0] TC — Timer Counter
0x08 PRE — Offset:0x08 CT16Bn Prescale Register
  [7:0] PRE — Prescalzer
0x0C PC — Offset:0x0C CT16Bn Prescale Counter Register
  [7:0] PC — Prescaler Counter
0x10 CNTCTRL — Offset:0x10 CT16Bn Counter Control Register
  [1:0] CTM — Counter/Timer Mode
    0=Timer_Mode_5 (Timer Mode: every rising PCLK edge); 1=Counter_Mode_1_3 (TC is incremented on rising edges on the CAP0 input selected by CIS bits.); 2=Counter_Mode_2_4 (TC is incremented on falling edges on the CAP0 input selected by CIS bits.); 3=Counter_Mode_3_6 (TC is incremented on both edges on the CAP0 input selected by CIS bits.)
0x14 MCTRL (reset mask 0xFFE0003F) — Offset:0x14 CT16Bn Match Control Register
  [55:24] PWMKEY wo — PWM register key.
  [46:23] MR9STOP — Stop TC and PC and clear CEN bit when MR9 matches TC
    0=Disable_434; 1=Enable_145 (Stop TC and PC and clear CEN bit when MR9 matches TC)
  [44:22] MR9RST — Enable reset TC when MR9 matches TC
    0=Disable_434; 1=Enable_145 (Reset TC when MR9 matches TC)
  [42:21] MR9IE — Enable generating an interrupt based on CM[2:0] when MR9 matches the value in the TC
    0=Disable_434; 1=Enable_145 (Generating an interrupt when MR9 matches TC)
  [10:5] MR1STOP — Stop TC and PC and clear CEN bit when MR1 matches TC
    0=Disable_434; 1=Enable_145 (Stop TC and PC and clear CEN bit when MR1 matches TC)
  [8:4] MR1RST — Enable reset TC when MR1 matches TC
    0=Disable_434; 1=Enable_145 (Reset TC when MR1 matches TC)
  [6:3] MR1IE — Enable generating an interrupt when MR1 matches TC
    0=Disable_434; 1=Enable_145 (Generating an interrupt when MR1 matches TC)
  [4:2] MR0STOP — Stop TC and PC and clear CEN bit when MR0 matches TC
    0=Disable_434; 1=Enable_145 (Stop TC and PC and clear CEN bit when MR0 matches TC)
  [2:1] MR0RST — Enable reset TC when MR0 matches TC
    0=Disable_434; 1=Enable_145 (Reset TC when MR0 matches TC)
  [0] MR0IE — Enable generating an interrupt when MR0 matches TC
    0=Disable_434; 1=Enable_145 (Generating an interrupt when MR0 matches TC)
0x20 MR0 (reset mask 0xFF00FFFF) — Offset:0x20 CT16Bn MR0 Register
  [55:24] PWMKEY wo — PWM register key.
  [15:0] MR — Timer counter match value
0x24 MR1 (reset mask 0xFF00FFFF) — Offset:0x24 CT16Bn MR1 Register
  fields as MR0
0x44 MR9 (reset mask 0xFF00FFFF) — Offset:0x44 CT16Bn MR9 Register
  fields as MR0
0x84 CAPCTRL (reset mask 0xF) — Offset:0x84 CT16Bn Capture Control Register
  [6:3] CAP0EN — CAP0 function enable
    0=Disable_434; 1=Enable_145 (Enable CAP0 function for external Capture pin)
  [4:2] CAP0IE — Interrupt on CT16Bn_CAP0 event
    0=Disable_434; 1=Enable_145 (A CAP0 load due to a CT16Bn_CAP0 event will generate an interrupt.)
  [2:1] CAP0FE — Capture/Reset on CT16Bn_CAP0 signal falling edge
    0=Disable_434; 1=Enable_145 (A sequence of 1 then 0 on CT16Bn_CAP0 will cause CAP0 to be loaded with the contents of TC.)
  [0] CAP0RE — Capture/Reset on CT16Bn_CAP0 signal rising edge
    0=Disable_434; 1=Enable_145 (A sequence of 0 then 1 on CT16Bn_CAP0 will cause CAP0 to be loaded with the contents of TC.)
0x88 CAP0 ro — Offset:0x88 CT16Bn CAP0 Register
  [15:0] CAP0 — Timer counter capture value
0x8C EM (reset mask 0xFF0000F3) — Offset:0x8C CT16Bn External Match Register
  [13:6] EMC1 — CT16Bn_PWM1 functionality
    0=Do_Nothing_7; 1=Low_4 (CT16Bn_PWM1 pin is LOW); 2=High_23 (CT16Bn_PWM1 pin is HIGH); 3=Toggle_4 (Toggle CT16Bn_PWM1 pin)
  [9:4] EMC0 — CT16Bn_PWM0 functionality
    0=Do_Nothing_7; 1=Low_4 (CT16Bn_PWM0 pin is LOW); 2=High_23 (CT16Bn_PWM0 pin is HIGH); 3=Toggle_4 (Toggle CT16Bn_PWM0 pin)
  [2:1] EM1 — When the TC matches MR1, this bit will act according to EMC1[1:0], and also drive the state of CT16Bn_PWM1 output.
  [0] EM0 — When the TC matches MR0, this bit will act according to EMC0[1:0], and also drive the state of CT16Bn_PWM0 output.
0x98 PWMCTRL (reset mask 0xFF3000F3) — Offset:0x98 CT16Bn PWM Control Register
  [55:24] PWMKEY wo — PWM register key.
  [42:21] PWM1IOEN — CT16Bn_PWM1/GPIO selection
    0=Disable_434 (CT16Bn_PWM1 pin is act as GPIO); 1=Enable_145 (CT16Bn_PWM1 pin act as match output, and output depends on PWM1EN bit)
  [40:20] PWM0IOEN — CT16Bn_PWM0/GPIO selection
    0=Disable_434 (CT16Bn_PWM0 pin is act as GPIO); 1=Enable_145 (CT16Bn_PWM0 pin act as match output, and output depends on PWM0EN bit)
  [13:6] PWM1MODE — PWM1 output mode
    0=PWM_mode_1_12 (During up-counting, PWM1 is 0 when TC is less than MR1.); 1=PWM_mode_2_13 (During up-counting, PWM1 is 1 when TC is less than MR1.); 2=Force_0 (PWM1 is forced to 0); 3=Force_1_24 (PWM1 is forced to 1)
  [9:4] PWM0MODE — PWM0 output mode
    0=PWM_mode_1_12 (During up-counting, PWM0 is 0 when TC is less than MR0.); 1=PWM_mode_2_13 (During up-counting, PWM0 is 1 when TC is less than MR0.); 2=Force_0 (PWM0 is forced to 0); 3=Force_1_24 (PWM0 is forced to 1)
  [2:1] PWM1EN — PWM1 enable
    0=Disable_434 (CT16Bn_PWM1 is controlled by EM1); 1=Enable_145 (Enable PWM mode for CT16Bn_PWM1)
  [0] PWM0EN — PWM0 enable
    0=Disable_434 (CT16Bn_PWM0 is controlled by EM0); 1=Enable_145 (Enable PWM mode for CT16Bn_PWM0)
0xA8 RIS ro (reset mask 0x33) — Offset:0xA8 CT16Bn Raw Interrupt Status Register
  [10:5] MR9IF — Match channel 9 interrupt flag
    0=No_interrupt_21 (No interrupt on match channel 9); 1=Met_interrupt_requirements_37 (Interrupt requirements met on match channel 9)
  [8:4] CAP0IF — Capture channel 0 interrupt flag
    0=No_58 (No interrupt on CAP0); 1=Met_interrupt_requirements_37 (Interrupt requirements met on CAP0)
  [2:1] MR1IF — Match channel 1 interrupt flag
    0=No_interrupt_21 (No interrupt on match channel 1); 1=Met_interrupt_requirements_37 (Interrupt requirements met on match channel 1)
  [0] MR0IF — Match channel 0 interrupt flag
    0=No_interrupt_21 (No interrupt on match channel 0); 1=Met_interrupt_requirements_37 (Interrupt requirements met on match channel 0)
0xAC IC wo (reset mask 0x33) — Offset:0xAC CT16Bn Interrupt Clear Register
  [10:5] MR9IC — MR9IF clear bit
    0=No_effect_200; 1=Clear_V_150 (Clear MR9IF)
  [8:4] CAP0IC — CAP0IF clear bit
    0=No_effect_200; 1=Clear_V_150 (Clear CAP0IF)
  [2:1] MR1IC — MR1IF clear bit
    0=No_effect_200; 1=Clear_V_150 (Clear MR1IF)
  [0] MR0IC — MR0IF clear bit
    0=No_effect_200; 1=Clear_V_150 (Clear MR0IF)
0xB0 PWMmNIOCTRL (reset mask 0xFF00000F) — Offset:0xB0 CT16Bn PWMmN IO Control register
  [55:24] PWMKEY wo — PWM register key.
  [5:2] PWM1NIOEN — CT16Bn_PWM0N/GPIO selection bit
    0=V_0_164 (CT16Bn_PWM1N pin is act as GPIO); 1=V_1_374 (CT16Bn_PWM1N pin outputs the inverse signal with dead-band of CT16Bn_PWM0, but same High signal during dead-band period); 2=V_2 (CT16Bn_PWM1N pin outputs the inverse signal with dead-band of CT16Bn_PWM0, but same Low signal during dead-band period); 3=V_3_20 (CT16Bn_PWM1N pin outputs the same signal with dead-band of CT16Bn_PWM0)
  [1:0] PWM0NIOEN — CT16Bn_PWM0N/GPIO selection bit
    0=V_0_164 (CT16Bn_PWM0N pin is act as GPIO); 1=V_1_374 (CT16Bn_PWM0N pin outputs the inverse signal with dead-band of CT16Bn_PWM0, but same High signal during dead-band period); 2=V_2 (CT16Bn_PWM0N pin outputs the inverse signal with dead-band of CT16Bn_PWM0, but same Low signal during dead-band period); 3=V_3_20 (CT16Bn_PWM0N pin outputs the same signal with dead-band of CT16Bn_PWM0)
0xB4 PWM0NDB (reset mask 0xFF0003FF) — Offset:0xB4 CT16Bn PWM0N Dead-band Period Register
  [55:24] PWMKEY wo — PWM register key.
  [9:0] DB — PWM0N output dead-band period time=DB*CT16Bn_PCLK*(PR+1) cycle
0xB8 PWM1NDB (reset mask 0xFF0003FF) — Offset:0xB8 CT16Bn PWM1N Dead-band Period Register
  [55:24] PWMKEY wo — PWM register key.
  [9:0] DB — PWM1N output dead-band period time=DB*CT16Bn_PCLK*(PR+1) cycle
