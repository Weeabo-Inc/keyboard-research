# SN32F290 register map
Vendor: SONIX; File version: 2026.10.03
CPU: CM0 r0p0, little endian, no MPU, no FPU, 2 interrupt priority bits
Registers are 32-bit, read-write, reset 0x0 unless marked. A register's access mark holds for its fields unless they carry their own. Offsets are from the block's base; [hi:lo] are bit positions; {n}, {i} and the like mark numbered series.

## SN_CT16B1 — 16-bit Timer 1 with Capture function
Base 0x40002000
0x00 TMRCTRL (reset mask 0x7) — Offset:0x00 CT16Bn Timer Control Register
  [4:2] CLKSEL — PCLK source
    0=HCLK_5 (CT16Bn PCLK source=HCLK); 1=PLL_VCO_5 (CT16Bn PCLK source=PLL_VCO)
  [2:1] CRST — Counter Reset
    0=Disable_434; 1=Reset_Counter (Timer Counter and the Prescale Counter are synchronously reset on the next positive edge of PCLK)
  [0] CEN — Counter enable
    0=Disable_434 (Disable counter); 1=Enable_145 (Enable Timer Counter and Prescale Counter for counting)
0x04 TC — Offset:0x04 CT16Bn Timer Counter Register
  [15:0] TC — Timer Counter
0x08 PRE — Offset:0x08 CT16Bn Prescale Register
  [7:0] PRE — Prescaler
0x0C PC — Offset:0x0C CT16Bn Prescale Counter Register
  [7:0] PC — Prescaler Counter
0x10 CNTCTRL — Offset:0x10 CT16Bn Counter Control Register
  [1:0] CTM — Counter/Timer Mode
    0=Timer_Mode_5 (Timer Mode: every rising PCLK edge); 1=Counter_Mode_1_3 (TC is incremented on rising edges on the CAP0 input selected by CIS bits.); 2=Counter_Mode_2_4 (TC is incremented on falling edges on the CAP0 input selected by CIS bits.); 3=Counter_Mode_3_6 (TC is incremented on both edges on the CAP0 input selected by CIS bits.)
0x14 MCTRL (reset mask 0x3FFFFFF) — Offset:0x14 CT16Bn Match Control Register
  [6n+4:3n+2] MR{n}STOP (n=0..9) — Stop TC and PC and clear CEN bit when MR{n} matches TC
    0=Disable_434; 1=Enable_145 (Stop TC and PC and clear CEN bit when MR{n} matches TC)
  [6n+2:3n+1] MR{n}RST (n=0..9) — Enable reset TC when MR{n} matches TC
    0=Disable_434; 1=Enable_145 (Reset TC when MR{n} matches TC)
  [6n:3n] MR{n}IE (n=1..9) — Enable generating an interrupt when MR{n} matches TC
    0=Disable_434; 1=Enable_145 (Generating an interrupt when MR{n} matches TC)
  [0] MR0IE — Enable generating an interrupt when MR0 matches TC
    0=Disable_434; 1=Enable_145 (Generating an interrupt when MR0 matches TC)
0x18 MCTRL2 (reset mask 0x1FF) — Offset:0x18 CT16Bn Match Control Register 2
  [16:8] MR12STOP — Stop TC and PC and clear CEN bit when MR12 matches TC
    0=Disable_434; 1=Enable_145 (Stop TC and PC and clear CEN bit when MR12 matches TC)
  [14:7] MR12RST — Enable reset TC when MR12 matches TC
    0=Disable_434; 1=Enable_145 (Reset TC when MR12 matches TC)
  [12:6] MR12IE — Enable generating an interrupt when MR12 matches TC
    0=Disable_434; 1=Enable_145 (Generating an interrupt when MR12 matches TC)
  [10:5] MR11STOP — Stop TC and PC and clear CEN bit when MR11 matches TC
    0=Disable_434; 1=Enable_145 (Stop TC and PC and clear CEN bit when MR11 matches TC)
  [8:4] MR11RST — Enable reset TC when MR11 matches TC
    0=Disable_434; 1=Enable_145 (Reset TC when MR11 matches TC)
  [6:3] MR11IE — Enable generating an interrupt when MR11 matches TC
    0=Disable_434; 1=Enable_145 (Generating an interrupt when MR11 matches TC)
  [4:2] MR10STOP — Stop TC and PC and clear CEN bit when MR10 matches TC
    0=Disable_434; 1=Enable_145 (Stop TC and PC and clear CEN bit when MR10 matches TC)
  [2:1] MR10RST — Enable reset TC when MR10 matches TC
    0=Disable_434; 1=Enable_145 (Reset TC when MR10 matches TC)
  [0] MR10IE — Enable generating an interrupt when MR10 matches TC
    0=Disable_434; 1=Enable_145 (Generating an interrupt when MR10 matches TC)
{0x20+4i} MR{i} (reset mask 0xFFFF) (i=0..12) — Offset:{0x20+4i} CT16Bn MR{i} Register
0x84 CAPCTRL (reset mask 0xF) — Offset:0x84 CT16Bn Capture Control Register
  [6:3] CAP0EN — CAP0 function enable
    0=Disable_434; 1=Enable_145 (Enable CAP0 function for external Capture pin)
  [4:2] CAP0IE — Interrupt on CT16Bn_CAP0 event
    0=Disable_434; 1=Enable_145 (A CAP0 load due to a CT16Bn_CAP0 event will generate an interrupt.)
  [2:1] CAP0FE — Capture/Reset on CT16Bn_CAP0 signal falling edge
    0=Disable_434; 1=Enable_145 (A sequence of 1 then 0 on CT16Bn_CAP0 will cause CAP0 to be loaded with the contents of TC.)
  [0] CAP0RE — Capture/Reset on CT16Bn_CAP0 signal rising edge
    0=Disable_434; 1=Enable_145 (A sequence of 0 then 1 on CT16Bn_CAP0 will cause CAP0 to be loaded with the contents of TC.)
0x88 CAP0 ro — Offset:0x88 CT16Bn CAP0 Register
  [15:0] CAP0 — Timer counter capture value
0x8C EM (reset mask 0xFFF) — Offset:0x8C CT16Bn External Match Register
  [2n:n] EM{n} (n=8..11) — When the TC matches MR{n}, this bit will act according to EMC{n}[1:0], and also drive the state of CT16Bn_PWM{n-8} output.
  [2n:n] EM{n} (n=4..7) — When the TC matches MR{n}, this bit will act according to EMC{n}[1:0], and also drive the state of CT16Bn_PWM{n-4} output.
  [6:3] EM3 — When the TC matches MR3, this bit will act according to EMC3[1:0], and also drive the state of CT16Bn_PWM3 output.
  [4:2] EM2 — When the TC matches MR2, this bit will act according to EMC2[1:0], and also drive the state of CT16Bn_PWM2 output.
  [2:1] EM1 — When the TC matches MR1, this bit will act according to EMC1[1:0], and also drive the state of CT16Bn_PWM1 output.
  [0] EM0 — When the TC matches MR0, this bit will act according to EMC0[1:0], and also drive the state of CT16Bn_PWM0 output.
0x90 EMC (reset mask 0xFFFFFF) — Offset:0x90 CT16Bn External Match Control register
  [4n+1:2n] EMC{n} (n=0..11) — CT16Bn_PWM{n} functionality
    0=Do_Nothing_7; 1=Low_4 (CT16Bn_PWM{n} pin is LOW); 2=High_23 (CT16Bn_PWM{n} pin is HIGH); 3=Toggle_4 (Toggle CT16Bn_PWM{n} pin)
0x98 PWMCTRL (reset mask 0xFFFFFF) — Offset:0x98 CT16Bn PWM Control Register
  [4n+1:2n] PWM{n}MODE (n=0..11) — PWM{n} output mode
    0=PWM_mode_1_12 (During up-counting, PWM{n} is 0 when TC is less than MR{n}. During down-counting, PWM{n} is 1 when TC is larger/equal than MR{n}); 1=PWM_mode_2_13 (During up-counting, PWM{n} is 1 when TC is less than MR{n}. During down-counting, PWM{n} is 0 when TC is larger/equal than MR{n}); 2=Force_0 (PWM{n} is forced to 0); 3=Force_1_24 (PWM{n} is forced to 1)
0xA0 PWMENB (reset mask 0xFFF) — Offset:0xA0 CT16Bn PWM Enable register
  [2n:n] PWM{n}EN (n=1..11) — PWM{n} enable
    0=Disable_434 (CT16Bn_PWM{n} is controlled by EM{n}); 1=Enable_145 (Enable PWM mode for CT16Bn_PWM{n})
  [0] PWM0EN — PWM0 enable
    0=Disable_434 (CT16Bn_PWM0 is controlled by EM0); 1=Enable_145 (Enable PWM mode for CT16Bn_PWM0)
0xA4 PWMIOENB (reset mask 0xFFF) — Offset:0xA4 CT16Bn PWM IO Enable register
  [2n:n] PWM{n}IOEN (n=1..11) — CT16Bn_PWM{n}/GPIO selection
    0=Disable_434 (CT16Bn_PWM{n} pin is act as GPIO); 1=Enable_145 (CT16Bn_PWM{n} pin act as match output, and output depends on PWM{n}EN bit)
  [0] PWM0IOEN — CT16Bn_PWM0/GPIO selection
    0=Disable_434 (CT16Bn_PWM0 pin is act as GPIO); 1=Enable_145 (CT16Bn_PWM0 pin act as match output, and output depends on PWM0EN bit)
0xA8 RIS ro (reset mask 0x3FFF) — Offset:0xA8 CT16Bn Raw Interrupt Status Register
  [26:13] CAP0IF — Capture channel 0 interrupt flag
    0=No_58 (No interrupt on CAP0); 1=Met_interrupt_requirements_37 (Interrupt requirements met on CAP0)
  [2n:n] MR{n}IF (n=9..12) — Match channel {n} interrupt flag
    0=No_58 (No interrupt on match channel {n}); 1=Met_interrupt_requirements_37 (Interrupt requirements met on match channel {n})
  [16:8] MR8IF — Match channel 8 interrupt flag
    0=No_interrupt_21 (No interrupt on match channel 8); 1=Met_interrupt_requirements_37 (Interrupt requirements met on match channel 8)
  [14:7] MR7IF — Match channel 7 interrupt flag
    0=No_58 (No interrupt on match channel 7); 1=Met_interrupt_requirements_37 (Interrupt requirements met on match channel 7)
  [12:6] MR6IF — Match channel 6 interrupt flag
    0=No_58 (No interrupt on match channel 6); 1=Met_interrupt_requirements_37 (Interrupt requirements met on match channel 6)
  [10:5] MR5IF — Match channel 5 interrupt flag
    0=No_58 (No interrupt on match channel 5); 1=Met_interrupt_requirements_37 (Interrupt requirements met on match channel 5)
  [8:4] MR4IF — Match channel 4 interrupt flag
    0=No_interrupt_21 (No interrupt on match channel 4); 1=Met_interrupt_requirements_37 (Interrupt requirements met on match channel 4)
  [6:3] MR3IF — Match channel 3 interrupt flag
    0=No_58 (No interrupt on match channel 3); 1=Met_interrupt_requirements_37 (Interrupt requirements met on match channel 3)
  [4:2] MR2IF — Match channel 2 interrupt flag
    0=No_58 (No interrupt on match channel 2); 1=Met_interrupt_requirements_37 (Interrupt requirements met on match channel 2)
  [2:1] MR1IF — Match channel 1 interrupt flag
    0=No_58 (No interrupt on match channel 1); 1=Met_interrupt_requirements_37 (Interrupt requirements met on match channel 1)
  [0] MR0IF — Match channel 0 interrupt flag
    0=No_interrupt_21 (No interrupt on match channel 0); 1=Met_interrupt_requirements_37 (Interrupt requirements met on match channel 0)
0xAC IC wo (reset mask 0x3FFF) — Offset:0xAC CT16Bn Interrupt Clear Register
  [26:13] CAP0IC — CAP0IF clear bit
    0=No_effect_200; 1=Clear_V_150 (Clear CAP0IF)
  [2n:n] MR{n}IC (n=1..12) — MR{n}IF clear bit
    0=No_effect_200; 1=Clear_V_150 (Clear MR{n}IF)
  [0] MR0IC — MR0IF clear bit
    0=No_effect_200; 1=Clear_V_150 (Clear MR0IF)
