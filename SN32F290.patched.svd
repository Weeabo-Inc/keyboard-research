# SN32F290 register map
Vendor: SONIX; File version: 2026.10.03
CPU: CM0 r0p0, little endian, no MPU, no FPU, 2 interrupt priority bits
Registers are 32-bit, read-write, reset 0x0 unless marked. A register's access mark holds for its fields unless they carry their own. Offsets are from the block's base; [hi:lo] are bit positions; {n}, {i} and the like mark numbered series; 'fields as' and 'values as' point back to an identical list.

## SN_CT16B2 — 16-bit Timer 2 with Capture function
Base 0x40004000
0x00 TMRCTRL (reset mask 0x77) — Offset:0x00 CT16Bn Timer Control Register
  [10:4] CM — Counting mode selection
    0=Up_counting_mode_3 (Edge-aligned Up-counting mode); 1=Down_counting_mode_2 (Edge-aligned Down-counting mode); 2=Center_aligned_counting_mode_1 (The match interrupt flag is set during the down-counting period); 4=Center_aligned_counting_mode_2 (The match interrupt flag is set during the up-counting period); 6=Center_aligned_counting_mode_3 (The match interrupt flag is set during both up-counting and down-counting period)
  [4:2] CLKSEL — PCLK source
    0=HCLK_5 (CT16Bn PCLK source=HCLK); 1=PLL_VCO_5 (CT16Bn PCLK source=PLL_VCO)
  [2:1] CRST — Counter Reset
    0=Disable_434; 1=Reset_Counter (Timer Counter and the Prescale Counter are synchronously reset on the next positive edge of PCLK)
  [0] CEN — Counter enable
    0=Disable_434 (Disable counter); 1=Enable_145 (Enable Timer Counter and Prescale Counter for counting)
0x04 TC — Offset:0x04 CT16Bn Timer Counter Register
  [15:0] TC — Timer Counter
0x08 PRE — Offset:0x08 CT16Bn Prescale Register
  [7:0] PRE — Prescalzer
0x0C PC — Offset:0x0C CT16Bn Prescale Counter Register
  [7:0] PC — Prescaler Counter
0x10 CNTCTRL — Offset:0x10 CT16Bn Counter Control Register
  [1:0] CTM — Counter/Timer Mode
    0=Timer_Mode_5 (Timer Mode: every rising PCLK edge); 1=Counter_Mode_1_3 (TC is incremented on rising edges on the CAP0 input selected by CIS bits.); 2=Counter_Mode_2_4 (TC is incremented on falling edges on the CAP0 input selected by CIS bits.); 3=Counter_Mode_3_6 (TC is incremented on both edges on the CAP0 input selected by CIS bits.)
0x14 MCTRL (reset mask 0xFFE00FFF) — Offset:0x14 CT16Bn Match Control Register
  [55:24] PWMKEY wo — PWM register key.
  [46:23] MR9STOP — Stop TC and PC and clear CEN bit when MR9 matches TC
    0=Disable_434; 1=Enable_145 (Stop TC and PC and clear CEN bit when MR9 matches TC)
  [44:22] MR9RST — Enable reset TC when MR9 matches TC
    0=Disable_434; 1=Enable_145 (Reset TC when MR9 matches TC)
  [42:21] MR9IE — Enable generating an interrupt when MR9 matches TC
    0=Disable_434; 1=Enable_145 (Generating an interrupt when MR9 matches TC)
  [6n+4:3n+2] MR{n}STOP (n=0..3) — Stop TC and PC and clear CEN bit when MR{n} matches TC
    0=Disable_434; 1=Enable_145 (Stop TC and PC and clear CEN bit when MR{n} matches TC)
  [6n+2:3n+1] MR{n}RST (n=0..3) — Enable reset TC when MR{n} matches TC
    0=Disable_434; 1=Enable_145 (Reset TC when MR{n} matches TC)
  [18:9] MR3IE — Enable generating an interrupt when MR3 matches TC
    0=Disable_434; 1=Enable_145 (Generating an interrupt when MR3 matches TC)
  [12:6] MR2IE — Enable generating an interrupt when MR2 matches TC
    0=Disable_434; 1=Enable_145 (Generating an interrupt when MR2 matches TC)
  [6:3] MR1IE — Enable generating an interrupt when MR1 matches TC
    0=Disable_434; 1=Enable_145 (Generating an interrupt when MR1 matches TC)
  [0] MR0IE — Enable generating an interrupt when MR0 matches TC
    0=Disable_434; 1=Enable_145 (Generating an interrupt when MR0 matches TC)
{0x20+4i} MR{i} (reset mask 0xFF00FFFF) (i=0..3) — Offset:{0x20+4i} CT16Bn MR{i} Register
  [55:24] PWMKEY wo — PWM register key.
  [15:0] MR — Timer counter match value
0x44 MR9 (reset mask 0xFF00FFFF) — Offset:0x44 CT16Bn MR9 Register
  fields as MR0
0x84 CAPCTRL (reset mask 0xF) — Offset:0x84 CT16Bn Capture Control Register
  [6:3] CAP0EN — CAP0 function enable
    0=Disable_434; 1=Enable_145 (Enable CAP0 function for external Capture pin)
  [4:2] CAP0IE — Interrupt on CT16Bn_CAP0 event
    0=Disable_434; 1=Enable_145 (A CAP0 load due to a CT16Bn_CAP0 event will generate an interrupt.)
  [2:1] CAP0FE — Capture/Reset on CT16Bn_CAP0 signal falling edge
    0=Disable_434; 1=Enable_145 (A sequence of 1 then 0 on CT16Bn_CAP0 will cause CAP0 to be loaded with the contents of TC.)
  [0] CAP0RE — Capture/Reset on CT16Bn_CAP0 signal rising edge
    0=Disable_434; 1=Enable_145 (A sequence of 0 then 1 on CT16Bn_CAP0 will cause CAP0 to be loaded with the contents of TC.)
0x88 CAP0 ro — Offset:0x88 CT16Bn CAP0 Register
  [15:0] CAP0 — Timer counter capture value
0x8C EM (reset mask 0xFF000FFF) — Offset:0x8C CT16Bn External Match Register
  [55:24] PWMKEY wo — PWM register key.
  [4n+9:2n+4] EMC{n} (n=0..3) — CT16Bn_PWM{n} functionality
    0=Do_Nothing_7; 1=Low_4 (CT16Bn_PWM{n} pin is LOW); 2=High_23 (CT16Bn_PWM{n} pin is HIGH); 3=Toggle_4 (Toggle CT16Bn_PWM{n} pin)
  [6:3] EM3 — When the TC matches MR3, this bit will act according to EMC3[1:0], and also drive the state of CT16Bn_PWM3 output.
  [4:2] EM2 — When the TC matches MR2, this bit will act according to EMC2[1:0], and also drive the state of CT16Bn_PWM2 output.
  [2:1] EM1 — When the TC matches MR1, this bit will act according to EMC1[1:0], and also drive the state of CT16Bn_PWM1 output.
  [0] EM0 — When the TC matches MR0, this bit will act according to EMC0[1:0], and also drive the state of CT16Bn_PWM0 output.
0x98 PWMCTRL (reset mask 0xFFF00FFF) — Offset:0x98 CT16Bn PWM Control Register
  [55:24] PWMKEY wo — PWM register key.
  [2n+40:n+20] PWM{n}IOEN (n=0..3) — CT16Bn_PWM{n}/GPIO selection
    0=Disable_434 (CT16Bn_PWM{n} pin is act as GPIO); 1=Enable_145 (CT16Bn_PWM{n} pin act as match output, and output depends on PWM{n}EN bit)
  [4n+9:2n+4] PWM{n}MODE (n=0..3) — PWM{n} output mode
    0=PWM_mode_1_12 (During up-counting, PWM{n} is 0 when TC is less than MR{n}.); 1=PWM_mode_2_13 (During up-counting, PWM{n} is 1 when TC is less than MR{n}.); 2=Force_0 (PWM{n} is forced to 0); 3=Force_1_24 (PWM{n} is forced to 1)
  [6:3] PWM3EN — PWM2 enable
    0=Disable_434 (CT16Bn_PWM3 is controlled by EM3); 1=Enable_145 (Enable PWM mode for CT16Bn_PWM3)
  [4:2] PWM2EN — PWM2 enable
    0=Disable_434 (CT16Bn_PWM2 is controlled by EM2); 1=Enable_145 (Enable PWM mode for CT16Bn_PWM2)
  [2:1] PWM1EN — PWM1 enable
    0=Disable_434 (CT16Bn_PWM1 is controlled by EM1); 1=Enable_145 (Enable PWM mode for CT16Bn_PWM1)
  [0] PWM0EN — PWM0 enable
    0=Disable_434 (CT16Bn_PWM0 is controlled by EM0); 1=Enable_145 (Enable PWM mode for CT16Bn_PWM0)
0xA8 RIS ro (reset mask 0x3F) — Offset:0xA8 CT16Bn Raw Interrupt Status Register
  [10:5] MR9IF — Match channel 9 interrupt flag
    0=No_interrupt_21 (No interrupt on match channel 9); 1=Met_interrupt_requirements_37 (Interrupt requirements met on match channel 9)
  [8:4] CAP0IF — Capture channel 0 interrupt flag
    0=No_58 (No interrupt on CAP0); 1=Met_interrupt_requirements_37 (Interrupt requirements met on CAP0)
  [6:3] MR3IF — Match channel 3 interrupt flag
    0=No_interrupt_21 (No interrupt on match channel 3); 1=Met_interrupt_requirements_37 (Interrupt requirements met on match channel 3)
  [4:2] MR2IF — Match channel 2 interrupt flag
    0=No_interrupt_21 (No interrupt on match channel 2); 1=Met_interrupt_requirements_37 (Interrupt requirements met on match channel 2)
  [2:1] MR1IF — Match channel 1 interrupt flag
    0=No_interrupt_21 (No interrupt on match channel 1); 1=Met_interrupt_requirements_37 (Interrupt requirements met on match channel 1)
  [0] MR0IF — Match channel 0 interrupt flag
    0=No_interrupt_21 (No interrupt on match channel 0); 1=Met_interrupt_requirements_37 (Interrupt requirements met on match channel 0)
0xAC IC wo (reset mask 0x3F) — Offset:0xAC CT16Bn Interrupt Clear Register
  [10:5] MR9IC — MR9IF clear bit
    0=No_effect_200; 1=Clear_V_150 (Clear MR9IF)
  [8:4] CAP0IC — CAP0IF clear bit
    0=No_effect_200; 1=Clear_V_150 (Clear CAP0IF)
  [6:3] MR3IC — MR3IF clear bit
    0=No_effect_200; 1=Clear_V_150 (Clear MR3IF)
  [4:2] MR2IC — MR2IF clear bit
    0=No_effect_200; 1=Clear_V_150 (Clear MR2IF)
  [2:1] MR1IC — MR1IF clear bit
    0=No_effect_200; 1=Clear_V_150 (Clear MR1IF)
  [0] MR0IC — MR0IF clear bit
    0=No_effect_200; 1=Clear_V_150 (Clear MR0IF)

## SN_CT16B5 — 16-bit Timer 5 with Capture function
Base 0x4000A000
Registers as SN_CT16B2; these are added or differ:
0x00 TMRCTRL (reset mask 0x7F) — Offset:0x00 CT16Bn Timer Control Register
  [10:4] CM — Counting mode selection
    values as SN_CT16B2.TMRCTRL.CM
  [5:2] CLKSEL — PCLK source
    0=HCLK_5 (CT16Bn PCLK source=HCLK); 1=PLL_VCO_5 (CT16Bn PCLK source=PLL_VCO); 2=ELS_Xtal (CT16Bn PCLK source=ELS Xtal)
  [2:1] CRST — Counter Reset
    0=Disable_434; 1=Reset_Counter (Timer Counter and the Prescale Counter are synchronously reset on the next positive edge of PCLK)
  [0] CEN — Counter enable
    0=Disable_434 (Disable counter); 1=Enable_145 (Enable Timer Counter and Prescale Counter for counting)
0x14 MCTRL (reset mask 0xFFE00FFF) — Offset:0x14 CT16Bn Match Control Register
  [55:24] PWMKEY wo — PWM register key.
  [46:23] MR9STOP — Stop TC and PC and clear CEN bit when MR9 matches TC
    0=Disable_434; 1=Enable_145 (Stop TC and PC and clear CEN bit when MR9 matches TC)
  [44:22] MR9RST — Enable reset TC when MR9 matches TC
    0=Disable_434; 1=Enable_145 (Reset TC when MR9 matches TC)
  [42:21] MR9IE — Enable generating an interrupt based on CM[2:0] when MR9 matches the value in the TC
    0=Disable_434; 1=Enable_145 (Generating an interrupt when MR9 matches TC)
  [6n+4:3n+2] MR{n}STOP (n=0..3) — Stop TC and PC and clear CEN bit when MR{n} matches TC
    0=Disable_434; 1=Enable_145 (Stop TC and PC and clear CEN bit when MR{n} matches TC)
  [6n+2:3n+1] MR{n}RST (n=0..3) — Enable reset TC when MR{n} matches TC
    0=Disable_434; 1=Enable_145 (Reset TC when MR{n} matches TC)
  [18:9] MR3IE — Enable generating an interrupt when MR3 matches TC
    0=Disable_434; 1=Enable_145 (Generating an interrupt when MR3 matches TC)
  [12:6] MR2IE — Enable generating an interrupt when MR2 matches TC
    0=Disable_434; 1=Enable_145 (Generating an interrupt when MR2 matches TC)
  [6:3] MR1IE — Enable generating an interrupt when MR1 matches TC
    0=Disable_434; 1=Enable_145 (Generating an interrupt when MR1 matches TC)
  [0] MR0IE — Enable generating an interrupt when MR0 matches TC
    0=Disable_434; 1=Enable_145 (Generating an interrupt when MR0 matches TC)
{0x20+4i} MR{i} (reset mask 0xFF00FFFF) (i=1..3) — Offset:{0x20+4i} CT16Bn MR{i} Register
  [55:24] PWMKEY wo — PWM register key
  [15:0] MR — Timer counter match value
0x44 MR9 (reset mask 0xFF00FFFF) — Offset:0x44 CT16Bn MR9 Register
  fields as MR1
