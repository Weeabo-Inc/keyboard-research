# SN32F290 register map
Vendor: SONIX; File version: 2026.10.03
CPU: CM0 r0p0, little endian, no MPU, no FPU, 2 interrupt priority bits
Registers are 32-bit, read-write, reset 0x0 unless marked. A register's access mark holds for its fields unless they carry their own. Offsets are from the block's base; [hi:lo] are bit positions; {n}, {i} and the like mark numbered series.

## SN_I2S0 — I2S
Base 0x4001A000
Same registers: SN_I2S1 0x40014000
0x00 CTRL reset 0x1F33400 (reset mask 0x81F77FFF) — Offset:0x00 I2Sn Control Register
  [62:31] I2SEN — I2S enable
    0=Disable_434 (Disable I2S); 1=Enable_145 (Enable I2S)
  [44:20] CHLENGTH — Bit number of single channel
    10=V_10 (11 bits); 11=V_11_3 (12 bits); 12=V_12 (13 bits); 13=V_13_3 (14 bits); 14=V_14 (15 bits); 15=V_15 (16 bits); 16=V_16_8 (17 bits); 17=V_17 (18 bits); 18=V_18_3 (19 bits); {v}=V_{v}_2 ({v+1} bits) (v=19..22); 23=V_23 (24 bits); 24=V_24 (25 bits); 25=V_25_2 (26 bits); 26=V_26_2 (27 bits); 27=V_27 (28 bits); 28=V_28_2 (29 bits); 29=V_29_2 (30 bits); 30=V_30 (31 bits); 31=V_31 (32 bits (Max)); 7=V_7_10 (8 bits); 8=V_8_2 (9 bits); 9=V_9_2 (10 bits)
  [34:16] RXFIFOTH — RX FIFO threshold level
    0=V_0_164 (RX FIFO threshold level=0); 1=V_1_374 (RX FIFO threshold level=1); 2=V_2 (RX FIFO threshold level=2); 3=V_3_20 (RX FIFO threshold level=3); 4=V_4_16 (RX FIFO threshold level=4); 5=V_5 (RX FIFO threshold level=5); 6=V_6_9 (RX FIFO threshold level=6); 7=V_7_10 (RX FIFO threshold level=7)
  [26:12] TXFIFOTH — TX FIFO threshold level
    0=V_0_164 (TX FIFO threshold level=0); 1=V_1_374 (TX FIFO threshold level=1); 2=V_2 (TX FIFO threshold level=2); 3=V_3_20 (TX FIFO threshold level=3); 4=V_4_16 (TX FIFO threshold level=4); 5=V_5 (TX FIFO threshold level=5); 6=V_6_9 (TX FIFO threshold level=6); 7=V_7_10 (TX FIFO threshold level=7)
  [21:10] DL — Data length
    0=V_8_2 (Data length=8 bits); 1=V_16_8 (Data length=16 bits); 2=V_24 (Data length=24 bits); 3=V_32 (Data length=32 bits)
  [18:9] CLRRXFIFO wo — Clear I2S RX FIFO
    0=V_0_164 (No effect); 1=V_1_374 (Reset RX FIFO)
  [16:8] CLRTXFIFO wo — Clear I2S TX FIFO
    0=V_0_164 (No effect); 1=V_1_374 (Reset TX FIFO)
  [14:7] RXEN — Receiver enable bit
    0=Disable_434 (Disable RX); 1=Enable_145 (Enable RX)
  [12:6] TXEN — Transmit enable bit
    0=Disable_434 (Disable TX); 1=Enable_145 (Enable TX)
  [9:4] FORMAT — I2S operation format
    0=V_0_164 (Standard I2S format); 1=V_01_2 (Left-justified format); 2=V_10 (Right(MSB)-justified format)
  [6:3] MS — Master/Slave selection bit
    0=Master_3 (Act as Master using internally generated BCLK and WS signals.); 1=Slave_6 (Act as Slave using externally BCLK and WS signals.)
  [4:2] MONO — Mono/stereo selection
    0=Stereo_2 (Stereo mode); 1=Mono mode
  [2:1] MUTE — Mute enable
    0=Disable_434 (Disable mute); 1=Enable_145 (Enable mute (I2SSDA output is 0))
  [0] START — Start Transmit/Receive
    0=Stop_5 (Stop transmit/receive); 1=Start transmit/receive
0x04 CLK reset 0x100 (reset mask 0x1FF1F) — Offset:0x04 I2Sn Clock Register
  [32:16] CLKSEL — I2S clock source
    0=HCLK_5 (HCLK is I2S clock source); 1=EHS_XTAL_5 (EHS Xtal is I2S clock source)
  [23:8] BCLKDIV — BCLK divider
  [8:4] MCLKSEL — MLCK source selection
    0=I2S_PCLK_2 (MCLK source of master is from I2S_PCLK); 1=GPIO_2 (MCLK source of master is from GPIO)
  [6:3] MCLKOEN — MLCK output enable
    0=Disable_434 (Disable MCLK output); 1=Enable_145 (Enable MCLK output)
  [2:0] MCLKDIV — MCLK divider
    0=V_0_164 (MCLK=MCLK source); 1=V_1_374 (MCLK=MCLK source/2); 2=V_2 (MCLK=MCLK source/4); 3=V_3_20 (MCLK=MCLK source/6); 4=V_4_16 (MCLK=MCLK source/8); 5=V_5 (MCLK=MCLK source/10); 6=V_6_9 (MCLK=MCLK source/12); 7=V_7_10 (MCLK=MCLK source/14)
0x08 STATUS ro reset 0x2 (reset mask 0x1EFFC3) — Offset:0x08 I2Sn Status Register
  [37:17] RXFIFOLV — RX FIFO used level
    0=V_0_164 (0/8 RX FIFO is used (Empty)); 1=V_1_374 (1/8 RX FIFO is used); 2=V_2 (2/8 RX FIFO is used); 3=V_3_20 (3/8 RX FIFO is used); 4=V_4_16 (4/8 RX FIFO is used); 5=V_5 (5/8 RX FIFO is used); 6=V_6_9 (6/8 RX FIFO is used); 7=V_7_10 (7/8 RX FIFO is used); 8=V_8_2 (8/8 RX FIFO is used (Full))
  [27:12] TXFIFOLV — TX FIFO used level
    0=V_0_164 (0/8 TX FIFO is used (Empty)); 1=V_1_374 (1/8 TX FIFO is used); 2=V_2 (2/8 TX FIFO is used); 3=V_3_20 (3/8 TX FIFO is used); 4=V_4_16 (4/8 TX FIFO is used); 5=V_5 (5/8 TX FIFO is used); 6=V_6_9 (6/8 TX FIFO is used); 7=V_7_10 (7/8 TX FIFO is used); 8=V_8_2 (8/8 TX FIFO is used (Full))
  [22:11] RXFIFOEMPTY — RX FIFO empty flag
    0=V_0_164 (RX FIFO is not empty); 1=V_1_374 (RX FIFO is empty)
  [20:10] TXFIFOEMPTY — TX FIFO empty flag
    0=V_0_164 (TX FIFO is not empty); 1=V_1_374 (TX FIFO is empty)
  [18:9] RXFIFOFULL — RX FIFO full flag
    0=V_0_164 (RX FIFO is not full); 1=V_1_374 (RX FIFO is full)
  [16:8] TXFIFOFULL — TX FIFO full flag
    0=Not_full_2 (TX FIFO is not full); 1=Full_2 (TX FIFO is full)
  [14:7] RXFIFOTHF — RX FIFO threshold flag
    0=V_0_164 (RXFIFOLV is less equal than RXFIFOTH); 1=V_1_374 (RXFIFOLV is larger than RXFIFOTH)
  [12:6] TXFIFOTHF — TX FIFO threshold flag
    0=V_0_164 (TXFIFOLV is larger equal than TXFIFOTH); 1=V_1_374 (TXFIFOLV is less than TXFIFOTH)
  [2:1] RIGHTCH — Current channel status
    0=Left_2 (Current channel is left channel); 1=Right_2 (Current channel is right channel)
  [0] I2SINT — I2S interrupt flag
    0=No_58 (No I2S interrupt); 1=Occurs_2 (I2S interrupt occurs)
0x0C IE (reset mask 0xF0) — Offset:0x0C I2Sn Interrupt Enable Register
  [14:7] RXFIFOTHIEN — RX FIFO threshold interrupt enable
    0=Disable_434 (Disable RX FIFO threshold interrupt); 1=Enable_145 (Enable RX FIFO threshold interrupt)
  [12:6] TXFIFOTHIEN — TX FIFO threshold interrupt enable
    0=Disable_434 (Disable TX FIFO threshold interrupt); 1=Enable_145 (Enable TX FIFO threshold interrupt)
  [10:5] RXFIFOUDFIEN — RX FIFO underflow interrupt enable
    0=Disable_434 (Disable RX FIFO underflow interrupt); 1=Enable_145 (Enable RX FIFO underflow interrupt)
  [8:4] TXFIFOOVFIEN — TX FIFO overflow interrupt enable
    0=Disable_434 (Disable TX FIFO overflow interrupt); 1=Enable_145 (Enable TX FIFO overflow interrupt)
0x10 RIS ro (reset mask 0xF0) — Offset:0x10 I2Sn Raw Interrupt Status Register
  [14:7] RXFIFOTHIF — RX FIFO threshold interrupt flag
    0=V_0_164 (No RX FIFO threshold interrupt); 1=V_1_374 (RX FIFO threshold triggered)
  [12:6] TXFIFOTHIF — TX FIFO threshold interrupt flag
    0=V_0_164 (No TX FIFO threshold interrupt); 1=V_1_374 (TX FIFO threshold triggered)
  [10:5] RXFIFOUDIF — RX FIFO underflow interrupt flag
    0=V_0_164 (No RX FIFO underflow); 1=V_1_374 (RX FIFO underflow)
  [8:4] TXFIFOOVIF — TX FIFO overflow interrupt flag
    0=V_0_164 (No TX FIFO overflow); 1=V_1_374 (TX FIFO overflow)
0x14 IC wo (reset mask 0x70) — Offset:0x14 I2Sn Interrupt Clear Register
  [14:7] RXFIFOTHIC — RX FIFO threshold interrupt clear
    0=No_effect_200; 1=Clear_V_150 (Clear RXFIFOTHIF bit)
  [12:6] TXFIFOTHIC — TX FIFO threshold interrupt clear
    0=No_effect_200; 1=Clear_V_150 (Clear TXFIFOTHIF bit)
  [10:5] RXFIFOUDIC — RX FIFO underflow interrupt clear
    0=No_effect_200; 1=Clear_V_150 (Clear RXFIFOUDIF bit)
  [8:4] TXFIFOOVIC — TX FIFO overflow interrupt clear
    0=No_effect_200; 1=Clear_V_150 (Clear TXFIFOOVIF bit)
0x18 RXFIFO ro — Offset:0x18 I2Sn RX FIFO Register
0x1C TXFIFO wo — Offset:0x1C I2Sn TX FIFO Register
