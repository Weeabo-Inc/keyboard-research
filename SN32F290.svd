# SN32F290 register map
Vendor: SONIX; File version: 2026.10.03
CPU: CM0 r0p0, little endian, 2 interrupt priority bits
Registers are 32-bit, read-write, reset 0x0 unless marked. A register's access mark holds for its fields unless they carry their own. Offsets are from the block's base; [hi:lo] are bit positions; {n}, {i} and the like mark numbered series.

## SN_I2S0 — I2S
Base 0x4001A000
Same registers: SN_I2S1 0x40014000
0x00 CTRL reset 0x1F33400 (reset mask 0x81F77FFF) — Offset:0x00 I2Sn Control Register
  [62:31] I2SEN — I2S enable
    0=Disable I2S; 1=Enable I2S
  [44:20] CHLENGTH — Bit number of single channel
    {v}={v+1} bits (v=7..30); 31=32 bits (Max)
  [34:16] RXFIFOTH — RX FIFO threshold level
    {v}=RX FIFO threshold level={v} (v=0..7)
  [26:12] TXFIFOTH — TX FIFO threshold level
    {v}=TX FIFO threshold level={v} (v=0..7)
  [21:10] DL — Data length
    0=Data length=8 bits; 1=Data length=16 bits; 2=Data length=24 bits; 3=Data length=32 bits
  [18:9] CLRRXFIFO wo — Clear I2S RX FIFO
    0=No effect; 1=Reset RX FIFO
  [16:8] CLRTXFIFO wo — Clear I2S TX FIFO
    0=No effect; 1=Reset TX FIFO
  [14:7] RXEN — Receiver enable bit
    0=Disable RX; 1=Enable RX
  [12:6] TXEN — Transmit enable bit
    0=Disable TX; 1=Enable TX
  [9:4] FORMAT — I2S operation format
    0=Standard I2S format; 1=Left-justified format; 2=Right(MSB)-justified format
  [6:3] MS — Master/Slave selection bit
    0=Master (Act as Master using internally generated BCLK and WS signals.); 1=Slave (Act as Slave using externally BCLK and WS signals.)
  [4:2] MONO — Mono/stereo selection
    0=Stereo mode; 1=Mono mode
  [2:1] MUTE — Mute enable
    0=Disable mute; 1=Enable mute (I2SSDA output is 0)
  [0] START — Start Transmit/Receive
    0=Stop transmit/receive; 1=Start transmit/receive
0x04 CLK reset 0x100 (reset mask 0x1FF1F) — Offset:0x04 I2Sn Clock Register
  [32:16] CLKSEL — I2S clock source
    0=HCLK (HCLK is I2S clock source); 1=EHS XTAL (EHS Xtal is I2S clock source)
  [23:8] BCLKDIV — BCLK divider
  [8:4] MCLKSEL — MLCK source selection
    0=I2S_PCLK (MCLK source of master is from I2S_PCLK); 1=GPIO (MCLK source of master is from GPIO)
  [6:3] MCLKOEN — MLCK output enable
    0=Disable MCLK output; 1=Enable MCLK output
  [2:0] MCLKDIV — MCLK divider
    0=MCLK=MCLK source; 1=MCLK=MCLK source/2; 2=MCLK=MCLK source/4; 3=MCLK=MCLK source/6; 4=MCLK=MCLK source/8; 5=MCLK=MCLK source/10; 6=MCLK=MCLK source/12; 7=MCLK=MCLK source/14
0x08 STATUS ro reset 0x2 (reset mask 0x1EFFC3) — Offset:0x08 I2Sn Status Register
  [37:17] RXFIFOLV — RX FIFO used level
    0=0/8 RX FIFO is used (Empty); {v}={v}/8 RX FIFO is used (v=1..7); 8=8/8 RX FIFO is used (Full)
  [27:12] TXFIFOLV — TX FIFO used level
    0=0/8 TX FIFO is used (Empty); {v}={v}/8 TX FIFO is used (v=1..7); 8=8/8 TX FIFO is used (Full)
  [22:11] RXFIFOEMPTY — RX FIFO empty flag
    0=RX FIFO is not empty; 1=RX FIFO is empty
  [20:10] TXFIFOEMPTY — TX FIFO empty flag
    0=TX FIFO is not empty; 1=TX FIFO is empty
  [18:9] RXFIFOFULL — RX FIFO full flag
    0=RX FIFO is not full; 1=RX FIFO is full
  [16:8] TXFIFOFULL — TX FIFO full flag
    0=Not full (TX FIFO is not full); 1=Full (TX FIFO is full)
  [14:7] RXFIFOTHF — RX FIFO threshold flag
    0=RXFIFOLV is less equal than RXFIFOTH; 1=RXFIFOLV is larger than RXFIFOTH
  [12:6] TXFIFOTHF — TX FIFO threshold flag
    0=TXFIFOLV is larger equal than TXFIFOTH; 1=TXFIFOLV is less than TXFIFOTH
  [2:1] RIGHTCH — Current channel status
    0=Left (Current channel is left channel); 1=Right (Current channel is right channel)
  [0] I2SINT — I2S interrupt flag
    0=No (No I2S interrupt); 1=Occurs (I2S interrupt occurs)
0x0C IE (reset mask 0xF0) — Offset:0x0C I2Sn Interrupt Enable Register
  [14:7] RXFIFOTHIEN — RX FIFO threshold interrupt enable
    0=Disable RX FIFO threshold interrupt; 1=Enable RX FIFO threshold interrupt
  [12:6] TXFIFOTHIEN — TX FIFO threshold interrupt enable
    0=Disable TX FIFO threshold interrupt; 1=Enable TX FIFO threshold interrupt
  [10:5] RXFIFOUDFIEN — RX FIFO underflow interrupt enable
    0=Disable RX FIFO underflow interrupt; 1=Enable RX FIFO underflow interrupt
  [8:4] TXFIFOOVFIEN — TX FIFO overflow interrupt enable
    0=Disable TX FIFO overflow interrupt; 1=Enable TX FIFO overflow interrupt
0x10 RIS ro (reset mask 0xF0) — Offset:0x10 I2Sn Raw Interrupt Status Register
  [14:7] RXFIFOTHIF — RX FIFO threshold interrupt flag
    0=No RX FIFO threshold interrupt; 1=RX FIFO threshold triggered
  [12:6] TXFIFOTHIF — TX FIFO threshold interrupt flag
    0=No TX FIFO threshold interrupt; 1=TX FIFO threshold triggered
  [10:5] RXFIFOUDIF — RX FIFO underflow interrupt flag
    0=No RX FIFO underflow; 1=RX FIFO underflow
  [8:4] TXFIFOOVIF — TX FIFO overflow interrupt flag
    0=No TX FIFO overflow; 1=TX FIFO overflow
0x14 IC wo (reset mask 0x70) — Offset:0x14 I2Sn Interrupt Clear Register
  [14:7] RXFIFOTHIC — RX FIFO threshold interrupt clear
    0=No effect; 1=Clear RXFIFOTHIF bit
  [12:6] TXFIFOTHIC — TX FIFO threshold interrupt clear
    0=No effect; 1=Clear TXFIFOTHIF bit
  [10:5] RXFIFOUDIC — RX FIFO underflow interrupt clear
    0=No effect; 1=Clear RXFIFOUDIF bit
  [8:4] TXFIFOOVIC — TX FIFO overflow interrupt clear
    0=No effect; 1=Clear TXFIFOOVIF bit
0x18 RXFIFO ro — Offset:0x18 I2Sn RX FIFO Register
0x1C TXFIFO wo — Offset:0x1C I2Sn TX FIFO Register
