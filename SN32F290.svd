# SN32F290 register map
Vendor: SONIX; File version: 2026.10.03
CPU: CM0 r0p0, little endian, 2 interrupt priority bits
Registers are 32-bit, read-write, reset 0x0 unless marked. A register's access mark holds for its fields unless they carry their own. Offsets are from the block's base; [hi:lo] are bit positions; {n}, {i} and the like mark numbered series.

## SN_LCD — LCD Driver
Base 0x40034000
0x00 CTRL reset 0x18 (reset mask 0x3FFFF) — Offset:0x00 LCD Control register
  [34:17] LCDOUT — LCD VLCD/C2/V1 debug pins output control bit
    0=Disable LCD voltage debug function; 1=Enable LCD voltage debug function
  [30:14] LCDBIA — LCD bias resistance selection bit
    0=Disable; 1=75K (75K Ohm); 2=225K (225K Ohm); 3=56.25K (56.25K Ohm); 4=900K (900K Ohm); 5=69.23K (69.23K Ohm); 6=180K (180K Ohm); 7=52.94K (52.94K Ohm)
  [25:12] LCDRATE — LCD clock rate
    0=/16 (LCD clock rate=LCD clock source/16); 1=/32 (LCD clock rate=LCD clock source/32); 2=/64 (LCD clock rate=LCD clock source/64); 3=/128 (LCD clock rate=LCD clock source/128)
  [22:11] LCDBNK — LCD blank control bit
    0=Normal display; 1=Blank (All LCD dots Off)
  [20:10] LCDCKS — LCD clock source selection
    0=ILRC (ILRC is LCD clock source); 1=ELS XTAL (ELS Xtal is LCD clock source)
  [17:8] LCDCOM — Duty selection
    0=1/4 duty (COM0~COM3 organize 1 frame); 1=1/6 duty (COM0~COM5 organize 1 frame); 2=1/7 duty (COM0~COM6 organize 1 frame); 3=1/8 duty (COM0~COM7 organize 1 frame)
  [14:7] LSTC — LCD static mode control bit
    0=1/3 bias (LCD driver is 1/3 bias); 1=Static (LCd driver is Static mode)
  [12:6] LCDSFM — LCD single frame function enable bit
    0=Disable LCD single frame function; 1=Enable LCD single frame function
  [10:5] LCDIDLE — LCD idle state enable bit
    0=Disable (When LCD is disabled, COM0~7 pins are GPIO); 1=Enable (When LCD is disabled, COM0~7 pins are V1 or VDD depends on LSTC bit)
  [5:1] VLCD — VLCD voltage adjustment
    0=VCC (VLCD=VCC); 1=0.97*VCC (VLCD=0.97*VCC); 10=0.67*VCC (VLCD=0.67*VCC); 11=0.63*VCC (VLCD=0.63*VCC); 12=0.60*VCC (VLCD=0.60*VCC); 13=0.57*VCC (VLCD=0.57*VCC); 14=0.53*VCC (VLCD=0.53*VCC); 15=0.50*VCC (VLCD=0.50*VCC); 2=0.93*VCC (VLCD=0.93*VCC); 3=0.90*VCC (VLCD=0.90*VCC); 4=0.87*VCC (VLCD=0.87*VCC); 5=0.83*VCC (VLCD=0.83*VCC); 6=0.80*VCC (VLCD=0.80*VCC); 7=0.77*VCC (VLCD=0.77*VCC); 8=0.73*VCC (VLCD=0.73*VCC); 9=0.70*VCC (VLCD=0.70*VCC)
  [0] LCDENB — LCD driver enable bit
    0=Disable LCD; 1=Enable LCD
0x04 FCC reset 0x2 (reset mask 0xFF) — Offset:0x04 LCD Frame Counter Control register
  [14:7] FCIE — LCD frame interrupt enable bit
    0=Disable LCD frame interrupt; 1=Enable LCD frame interrupt
  [7:1] FCT — LCD frame counter threshold value
  [0] FCENB — LCD frame counter enable bit
    0=Disable LCD frame counter; 1=Enable LCD frame counter
0x08 RIS — Offset:0x08 LCD Raw Interrupt Status register
  [0] FCIF — LCD frame interrupt flag
    0=No (No interrupt); 1=Met (FC interrupt requirements met)
0x0C SEGSEL1 — Offset:0x0C LCD SEG Select register 1
  [2n:n] SEG{n}EN (n=1..31) — SEG{n} Enable bit
    0=Disable SEG{n}; 1=Enable SEG{n}
  [0] SEG0EN — SEG0 Enable bit
    0=Disable SEG0; 1=Enable SEG0
0x10 SEGSEL2 (reset mask 0xFF) — Offset:0x10 LCD SEG Select register 2
  [2n-64:n-32] SEG{n}EN (n=33..39) — SEG{n} Enable bit
    0=Disable SEG{n}; 1=Enable SEG{n}
  [0] SEG32EN — SEG32 Enable bit
    0=Disable SEG32; 1=Enable SEG32
0x14 SEGM0 — Offset:0x14 LCD SEG Memory register 0
  [16n+7:8n] SEG{n} (n=0..3) — SEG{n} data for COM0~COM7
0x18 SEGM1 — Offset:0x18 LCD SEG Memory register 1
  [16n-57:8n-32] SEG{n} (n=4..7) — SEG{n} data for COM0~COM7
0x1C SEGM2 — Offset:0x1C LCD SEG Memory register 2
  [16n-121:8n-64] SEG{n} (n=8..11) — SEG{n} data for COM0~COM7
0x20 SEGM3 — Offset:0x20 LCD SEG Memory register 3
  [16n-185:8n-96] SEG{n} (n=12..15) — SEG{n} data for COM0~COM7
0x24 SEGM4 — Offset:0x24 LCD SEG Memory register 4
  [16n-249:8n-128] SEG{n} (n=16..19) — SEG{n} data for COM0~COM7
0x28 SEGM5 — Offset:0x28 LCD SEG Memory register 5
  [16n-313:8n-160] SEG{n} (n=20..23) — SEG{n} data for COM0~COM7
0x2C SEGM6 — Offset:0x2C LCD SEG Memory register 6
  [16n-377:8n-192] SEG{n} (n=24..27) — SEG{n} data for COM0~COM7
0x30 SEGM7 — Offset:0x30 LCD SEG Memory register 7
  [16n-441:8n-224] SEG{n} (n=28..31) — SEG{n} data for COM0~COM7
0x34 SEGM8 — Offset:0x34 LCD SEG Memory register 8
  [16n-505:8n-256] SEG{n} (n=32..35) — SEG{n} data for COM0~COM7
0x38 SEGM9 — Offset:0x38 LCD SEG Memory register 9
  [16n-569:8n-288] SEG{n} (n=36..39) — SEG{n} data for COM0~COM7
