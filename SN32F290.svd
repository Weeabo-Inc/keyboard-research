# SN32F290 register map
Vendor: SONIX; File version: 2026.10.03
CPU: CM0 r0p0, little endian, 2 interrupt priority bits
Registers are 32-bit, read-write, reset 0x0 unless marked. A register's access mark holds for its fields unless they carry their own. Offsets are from the block's base; [hi:lo] are bit positions.

## SN_PFPA — Peripheral Function Pin Assignment
Base 0x40042000
0x00 CT16B0 (reset mask 0xFFFF) — Offset:0x00 PFPA for CT16B0 Register
  [29:14] PWM3N — CT16B0_PWM3N assigned pin
    0=P0.0 (CT16B0_PWM3N=P0.0); 1=P1.16 (CT16B0_PWM3N=P1.16); 2=P0.2 (CT16B0_PWM3N=P0.2); 3=P2.15 (CT16B0_PWM3N=P2.15)
  [25:12] PWM3 — CT16B0_PWM3 assigned pin
    0=P0.1 (CT16B0_PWM3=P0.1); 1=P3.3 (CT16B0_PWM3=P3.3); 2=P0.3 (CT16B0_PWM3=P0.3); 3=P2.14 (CT16B0_PWM3=P2.14)
  [21:10] PWM2N — CT16B0_PWM2N assigned pin
    0=P1.15 (CT16B0_PWM2N=P1.15); 1=P2.6 (CT16B0_PWM2N=P2.6); 2=P2.9 (CT16B0_PWM2N=P2.9); 3=P0.1 (CT16B0_PWM2N=P0.1)
  [17:8] PWM2 — CT16B0_PWM2 assigned pin
    0=P2.7 (CT16B0_PWM2=P2.7); 1=P3.2 (CT16B0_PWM2=P3.2); 2=P0.0 (CT16B0_PWM2=P0.0); 3=P2.8 (CT16B0_PWM2=P2.8)
  [13:6] PWM1N — CT16B0_PWM1N assigned pin
    0=P1.14 (CT16B0_PWM1N=P1.14); 1=P0.0 (CT16B0_PWM1N=P0.0); 2=P2.8 (CT16B0_PWM1N=P2.8); 3=P2.4 (CT16B0_PWM1N=P2.4)
  [9:4] PWM1 — CT16B0_PWM1 assigned pin
    0=P2.9 (CT16B0_PWM1=P2.9); 1=P3.1 (CT16B0_PWM1=P3.1); 2=P0.1 (CT16B0_PWM1=P0.1); 3=P2.5 (CT16B0_PWM1=P2.5)
  [5:2] PWM0N — CT16B0_PWM0N assigned pin
    0=P0.3 (CT16B0_PWM0N=P0.3); 1=P1.13 (CT16B0_PWM0N=P1.13); 2=P2.7 (CT16B0_PWM0N=P2.7); 3=P0.12 (CT16B0_PWM0N=P0.12)
  [1:0] PWM0 — CT16B0_PWM0 assigned pin
    0=P0.2 (CT16B0_PWM0=P0.2); 1=P3.0 (CT16B0_PWM0=P3.0); 2=P2.6 (CT16B0_PWM0=P2.6); 3=P1.12 (CT16B0_PWM0=P1.12)
0x04 CT16B1 (reset mask 0xFFF) — Offset:0x04 PFPA for CT16B1 Register
  [22:11] PWM11 — CT16B1_PWM11 assigned pin
    0=P0.11 (CT16B1_PWM11=P0.11); 1=P2.9 (CT16B1_PWM11=P2.9)
  [20:10] PWM10 — CT16B1_PWM10 assigned pin
    0=P0.10 (CT16B1_PWM10=P0.10); 1=P2.7 (CT16B1_PWM10=P2.7)
  [18:9] PWM09 — CT16B1_PWM09 assigned pin
    0=P0.9 (CT16B1_PWM09=P0.9); 1=P2.4 (CT16B1_PWM09=P2.4)
  [16:8] PWM08 — CT16B1_PWM08 assigned pin
    0=P0.8 (CT16B1_PWM08=P0.8); 1=P2.0 (CT16B1_PWM08=P2.0)
  [14:7] PWM07 — CT16B1_PWM07 assigned pin
    0=P0.7 (CT16B1_PWM07=P0.7); 1=P1.15 (CT16B1_PWM07=P1.15)
  [12:6] PWM06 — CT16B1_PWM06 assigned pin
    0=P0.6 (CT16B1_PWM06=P0.6); 1=P1.14 (CT16B1_PWM06=P1.14)
  [10:5] PWM05 — CT16B1_PWM05 assigned pin
    0=P0.5 (CT16B1_PWM05=P0.5); 1=P1.13 (CT16B1_PWM05=P1.13)
  [8:4] PWM04 — CT16B1_PWM04 assigned pin
    0=P0.4 (CT16B1_PWM04=P0.4); 1=P1.12 (CT16B1_PWM04=P1.12)
  [6:3] PWM03 — CT16B1_PWM03 assigned pin
    0=P0.3 (CT16B1_PWM03=P0.3); 1=P1.11 (CT16B1_PWM03=P1.11)
  [4:2] PWM02 — CT16B1_PWM02 assigned pin
    0=P0.2 (CT16B1_PWM02=P0.2); 1=P1.10 (CT16B1_PWM02=P1.10)
  [2:1] PWM01 — CT16B1_PWM01 assigned pin
    0=P0.1 (CT16B1_PWM01=P0.1); 1=P1.9 (CT16B1_PWM01=P1.9)
  [0] PWM00 — CT16B1_PWM00 assigned pin
    0=P0.0 (CT16B1_PWM00=P0.0); 1=P1.8 (CT16B1_PWM00=P1.8)
0x08 UART (reset mask 0xFFFF) — Offset:0x08 PFPA for UART Register
  [29:14] URXD3 — URXD3 assigned pin
    0=P3.13 (URXD3=P3.13); 1=P1.6 (URXD3=P1.6); 2=P2.1 (URXD3=P2.1)
  [25:12] UTXD3 — UTXD3 assigned pin
    0=P3.12 (UTXD3=P3.12); 1=P1.7 (UTXD3=P1.7); 2=P2.0 (UTXD3=P2.0)
  [21:10] URXD2 — URXD2 assigned pin
    0=P0.2 (URXD2=P0.2); 1=P1.3 (URXD2=P1.3); 2=P2.15 (URXD2=P2.15); 3=P1.6 (URXD2=P1.6)
  [17:8] UTXD2 — UTXD2 assigned pin
    0=P0.1 (UTXD2=P0.1); 1=P1.4 (UTXD2=P1.4); 2=P2.14 (UTXD2=P2.14); 3=P1.7 (UTXD2=P1.7)
  [13:6] URXD1 — URXD1 assigned pin
    0=P1.8 (URXD1=P1.8); 1=P2.3 (URXD1=P2.3); 2=P1.17 (URXD1=P1.17); 3=P3.4 (URXD1=P3.4)
  [9:4] UTXD1 — UTXD1 assigned pin
    0=P1.9 (UTXD1=P1.9); 1=P2.2 (UTXD1=P2.2); 2=P1.16 (UTXD1=P1.16); 3=P3.6 (UTXD1=P3.6)
  [5:2] URXD0 — URXD0 assigned pin
    0=P0.11 (URXD0=P0.11); 1=P2.0 (URXD0=P2.0); 2=P3.2 (URXD0=P3.2)
  [1:0] UTXD0 — UTXD0 assigned pin
    0=P0.10 (UTXD0=P0.10); 1=P2.1 (UTXD0=P2.1); 2=P3.1 (UTXD0=P3.1)
0x0C I2C (reset mask 0xFF) — Offset:0x0C PFPA for I2C Register
  [13:6] SCL1 — SCL1 assigned pin
    0=P1.10 (SCL1=P1.10); 1=P1.13 (SCL1=P1.13); 2=P0.1 (SCL1=P0.1); 3=P1.8 (SCL1=P1.8)
  [9:4] SDA1 — SDA1 assigned pin
    0=P1.11 (SDA1=P1.11); 1=P1.14 (SDA1=P1.14); 2=P0.2 (SDA1=P0.2); 3=P1.9 (SDA1=P1.9)
  [5:2] SCL0 — SCL0 assigned pin
    0=P0.6 (SCL0=P0.6); 1=P1.4 (SCL0=P1.4); 2=P0.10 (SCL0=P0.10); 3=P1.1 (SCL0=P1.1)
  [1:0] SDA0 — SDA0 assigned pin
    0=P0.7 (SDA0=P0.7); 1=P1.5 (SDA0=P1.5); 2=P0.11 (SDA0=P0.11); 3=P1.2 (SDA0=P1.2)
0x10 SPI (reset mask 0xFFFF) — Offset:0x10 PFPA for SPI Register
  [29:14] SEL1 — SEL1 assigned pin
    0=P1.12 (SEL1=P1.12); 1=P1.9 (SEL1=P1.9); 2=P1.5 (SEL1=P1.5); 3=P0.13 (SEL1=P0.13)
  [25:12] SCK1 — SCK1 assigned pin
    0=P1.13 (SCK1=P1.13); 1=P1.8 (SCK1=P1.8); 2=P0.1 (SCK1=P0.1); 3=P0.12 (SCK1=P0.12)
  [21:10] MOSI1 — MOSI1 assigned pin
    0=P1.15 (MOSI1=P1.15); 1=P1.11 (MOSI1=P1.11); 2=P2.13 (MOSI1=P2.13); 3=P3.15 (MOSI1=P3.15)
  [17:8] MISO1 — MISO1 assigned pin
    0=P1.14 (MISO1=P1.14); 1=P1.10 (MISO1=P1.10); 2=P2.12 (MISO1=P2.12); 3=P3.14 (MISO1=P3.14)
  [13:6] SEL0 — SEL0 assigned pin
    0=P0.1 (SEL0=P0.1); 1=P2.4 (SEL0=P2.4); 2=P1.8 (SEL0=P1.8); 3=P1.7 (SCK0=P1.7)
  [9:4] SCK0 — SCK0 assigned pin
    0=P0.0 (SCK0=P0.0); 1=P2.5 (SCK0=P2.5); 2=P1.0 (SCK0=P1.0); 3=P3.0 (SCK0=P3.0)
  [5:2] MOSI0 — MOSI0 assigned pin
    0=P0.3 (MOSI0=P0.3); 1=P2.7 (MOSI0=P2.7); 2=P1.2 (MOSI0=P1.2); 3=P3.2 (MOSI0=P3.2)
  [1:0] MISO0 — MISO0 assigned pin
    0=P0.2 (MISO0=P0.2); 1=P2.6 (MISO0=P2.6); 2=P1.1 (MISO0=P1.1); 3=P3.1 (MISO0=P3.1)
0x14 I2S (reset mask 0xFFFFF) — Offset:0x14 PFPA for I2S Register
  [37:18] DIN1 — DIN1 assigned pin
    0=P3.18 (DIN0=P3.18); 1=P1.1 (DIN0=P1.1); 2=P1.19 (DIN0=P1.19); 3=P1.10 (DIN0=P1.10)
  [33:16] DOUT1 — DOUT1 assigned pin
    0=P3.15 (DOUT1=P3.15); 1=P1.2 (DOUT1=P1.2); 2=P1.15 (DOUT1=P1.15); 3=P2.13 (DOUT1=P2.13)
  [29:14] WS1 — WS1 assigned pin
    0=P3.16 (WS1=P3.16); 1=P1.5 (WS1=P1.5); 2=P1.12 (WS1=P1.12); 3=P1.9 (WS1=P1.9)
  [25:12] BCLK1 — BCLK1 assigned pin
    0=P3.17 (BCLK1=P3.17); 1=P1.6 (BCLK1=P1.6); 2=P1.13 (BCLK1=P1.13); 3=P0.1 (BCLK1=P0.1)
  [21:10] MCLK1 — MCLK1 assigned pin
    0=P3.14 (MCLK1=P3.14); 1=P1.7 (MCLK1=P1.7); 2=P1.14 (MCLK1=P1.14); 3=P2.12 (MCLK1=P2.12)
  [17:8] DIN0 — DIN0 assigned pin
    0=P3.4 (DIN0=P3.4); 1=P2.8 (DIN0=P2.8); 2=P1.3 (DIN0=P1.3)
  [13:6] DOUT0 — DOUT0 assigned pin
    0=P3.3 (DOUT0=P3.3); 1=P2.7 (DOUT0=P2.7); 2=P1.2 (DOUT0=P1.2)
  [9:4] WS0 — WS0 assigned pin
    0=P3.2 (WS0=P3.2); 1=P2.4 (WS0=P2.4); 2=P1.8 (WS0=P1.8)
  [5:2] BCLK0 — BCLK0 assigned pin
    0=P3.1 (BCLK0=P3.1); 1=P2.5 (BCLK0=P2.5); 2=P1.0 (BCLK0=P1.0)
  [1:0] MCLK0 — MCLK0 assigned pin
    0=P3.0 (MCLK0=P3.0); 1=P2.6 (MCLK0=P2.6); 2=P1.1 (MCLK0=P1.1)
0x18 CT16B2 (reset mask 0xFF) — Offset:0x18 PFPA for CT16B2 Register
  [13:6] PWM3 — CT16B2_PWM3 assigned pin
    0=P2.3 (CT16B2_PWM3=P2.3); 1=P0.2 (CT16B2_PWM3=P0.2); 2=P1.10 (CT16B2_PWM3=P1.10); 3=P1.17 (CT16B2_PWM3=P1.17)
  [9:4] PWM2 — CT16B2_PWM2 assigned pin
    0=P2.2 (CT16B2_PWM2=P2.2); 1=P0.1 (CT16B2_PWM2=P0.1); 2=P1.6 (CT16B2_PWM2=P1.6); 3=P1.18 (CT16B2_PWM2=P1.18)
  [5:2] PWM1 — CT16B2_PWM1 assigned pin
    0=P2.1 (CT16B2_PWM1=P2.1); 1=P1.0 (CT16B2_PWM1=P1.0); 2=P1.7 (CT16B2_PWM1=P1.7); 3=P0.3 (CT16B2_PWM1=P0.3)
  [1:0] PWM0 — CT16B2_PWM0 assigned pin
    0=P2.0 (CT16B2_PWM0=P2.0); 1=P2.5 (CT16B2_PWM0=P2.5); 2=P1.8 (CT16B2_PWM0=P1.8); 3=P0.0 (CT16B2_PWM0=P0.0)
0x1C CT16B3 (reset mask 0xFF) — Offset:0x1C PFPA for CT16B3 Register
  [13:6] PWM1N — CT16B0_PWM1N assigned pin
    0=P2.4 (CT16B0_PWM1N=P2.4); 1=P0.11 (CT16B0_PWM1N=P0.11); 2=P1.13 (CT16B0_PWM1N=P1.13); 3=P0.8 (CT16B0_PWM1N=P0.8)
  [9:4] PWM1 — CT16B3_PWM1 assigned pin
    0=P2.3 (CT16B3_PWM1=P2.3); 1=P1.15 (CT16B3_PWM1=P1.15); 2=P1.12 (CT16B3_PWM1=P1.12); 3=P1.5 (CT16B3_PWM1=P1.5)
  [5:2] PWM0N — CT16B3_PWM0N assigned pin
    0=P1.15 (CT16B3_PWM0N=P1.15); 1=P2.1 (CT16B3_PWM0N=P2.1); 2=P0.10 (CT16B3_PWM0N=P0.10); 3=P1.3 (CT16B3_PWM0N=P1.3)
  [1:0] PWM0 — CT16B3_PWM0 assigned pin
    0=P1.14 (CT16B3_PWM0=P1.14); 1=P2.2 (CT16B3_PWM0=P2.2); 2=P2.6 (CT16B3_PWM0=P2.6); 3=P1.4 (CT16B3_PWM0=P1.4)
0x20 CT16B4 (reset mask 0xFF) — Offset:0x20 PFPA for CT16B4 Register
  [13:6] PWM1N — CT16B4_PWM1N assigned pin
    0=P0.10 (CT16B4_PWM1N=P0.10); 1=P1.3 (CT16B4_PWM1N=P1.3); 2=P2.4 (CT16B4_PWM1N=P2.4); 3=P1.13 (CT16B4_PWM1N=P1.13)
  [9:4] PWM1 — CT16B4_PWM1 assigned pin
    0=P2.6 (CT16B4_PWM1=P2.6); 1=P1.4 (CT16B4_PWM1=P1.4); 2=P2.5 (CT16B4_PWM1=P2.5); 3=P1.12 (CT16B4_PWM1=P1.12)
  [5:2] PWM0N — CT16B4_PWM0N assigned pin
    0=P0.11 (CT16B4_PWM0N=P0.11); 1=P2.6 (CT16B4_PWM0N=P2.6); 2=P1.2 (CT16B4_PWM0N=P1.2); 3=P0.8 (CT16B4_PWM0N=P0.8)
  [1:0] PWM0 — CT16B4_PWM0 assigned pin
    0=P2.7 (CT16B4_PWM0=P2.7); 1=P1.5 (CT16B4_PWM0=P1.5); 2=P0.10 (CT16B4_PWM0=P0.10); 3=P0.9 (CT16B4_PWM0=P0.9)
0x24 CT16B5 (reset mask 0xFF) — Offset:0x24 PFPA for CT16B5 Register
  [13:6] PWM3 — CT16B5_PWM3 assigned pin
    0=P2.9 (CT16B5_PWM3=P2.9); 1=P0.12 (CT16B5_PWM3=P0.12); 2=P1.18 (CT16B5_PWM3=P1.18); 3=P3.19 (CT16B5_PWM3=P3.19)
  [9:4] PWM2 — CT16B5_PWM2 assigned pin
    0=P2.8 (CT16B5_PWM2=P2.8); 1=P0.13 (CT16B5_PWM2=P0.13); 2=P1.0 (CT16B5_PWM2=P1.0); 3=P3.18 (CT16B5_PWM2=P3.18)
  [5:2] PWM1 — CT16B5_PWM1 assigned pin
    0=P2.7 (CT16B5_PWM1=P2.7); 1=P0.14 (CT16B5_PWM1=P0.14); 2=P1.2 (CT16B5_PWM1=P1.2); 3=P3.17 (CT16B2_PWM5=P3.17)
  [1:0] PWM0 — CT16B5_PWM0 assigned pin
    0=P2.6 (CT16B5_PWM0=P2.6); 1=P0.15 (CT16B5_PWM0=P0.15); 2=P1.1 (CT16B5_PWM0=P1.1); 3=P3.16 (CT16B5_PWM0=P3.16)
